/*
 * Copyright (c) 2020 Ryan Cross
 *
 * SPDX-License-Identifier: MIT
 */

#include "dactylM.dtsi"

&kscan0 {
	col-gpios
		= <&pro_micro 10 GPIO_ACTIVE_HIGH>
		, <&pro_micro 11 GPIO_ACTIVE_HIGH>
		, <&pro_micro 12 GPIO_ACTIVE_HIGH>
		, <&pro_micro 13 GPIO_ACTIVE_HIGH>
		, <&pro_micro 14 GPIO_ACTIVE_HIGH>
		, <&pro_micro 15 GPIO_ACTIVE_HIGH>
		;
};

&left_encoder {
	status = "okay";
};
