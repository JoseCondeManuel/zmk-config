## config/boards/shield/sofleRGB/Kconfig.defconfig
```kconfig
# Copyright (c) 2021 The ZMK Contributors
# SPDX-License-Identifier: MIT

if SHIELD_sofleRGB_LEFT

config ZMK_KEYBOARD_NAME
    default "sofleRGB"

config ZMK_SPLIT_BLE_ROLE_CENTRAL
    default y

endif

if SHIELD_sofleRGB_LEFT || SHIELD_sofleRGB_RIGHT

config ZMK_SPLIT
    default y

endif
```

## config/boards/shields/dactylM/Kconfig.defconfig
```kconfig
# Copyright (c) 2020 Ryan Cross
# SPDX-License-Identifier: MIT

if SHIELD_DACTYLM_LEFT

config ZMK_KEYBOARD_NAME
	default "DactylM"

config ZMK_SPLIT_BLE_ROLE_CENTRAL
	default y
	
endif

if SHIELD_DACTYLM_LEFT || SHIELD_DACTYLM_RIGHT

config ZMK_SPLIT
	default y

endif
```

## config/boards/shields/dactylM/Kconfig.shield
```kconfig
config SHIELD_DACTYLM_LEFT
    def_bool $(shields_list_contains,dactylM_left)

config SHIELD_DACTYLM_RIGHT
    def_bool $(shields_list_contains,dactylM_right)
```

## config/boards/shields/sofleRGB/Kconfig.shield
```kconfig
config SHIELD_SOFLERGB_LEFT
    def_bool $(shields_list_contains,sofleRGB_left)

config SHIELD_SOFLERGB_RIGHT
    def_bool $(shields_list_contains,sofleRGB_right)
```

## config/west.yml
```yaml
manifest:
  remotes:
    - name: zmkfirmware
      url-base: https://github.com/zmkfirmware
    - name: JoseCondeManuel
      url-base: https://github.com/josecondemanuel
  projects:
    - name: zmk
      remote: zmkfirmware
      revision: main
      import: app/west.yml
  self:
    path: config
```
